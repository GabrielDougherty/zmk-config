## config/boards/shields/custom_split/Kconfig.defconfig
```kconfig
# Copyright (c) 2020 The ZMK Contributors
# SPDX-License-Identifier: MIT

if SHIELD_CUSTOM_SPLIT_LEFT

# Name must be less than 16 characters long!
config ZMK_KEYBOARD_NAME
    default "Gabe Split KB"

config ZMK_SPLIT_ROLE_CENTRAL
    default y

endif

if SHIELD_CUSTOM_SPLIT_LEFT || SHIELD_CUSTOM_SPLIT_RIGHT

config ZMK_SPLIT
    default y

endif
```

## config/boards/shields/custom_split/Kconfig.shield
```kconfig
# Copyright (c) 2020 The ZMK Contributors
# SPDX-License-Identifier: MIT

config SHIELD_CUSTOM_SPLIT_LEFT
	def_bool $(shields_list_contains,custom_split_left)

config SHIELD_CUSTOM_SPLIT_RIGHT
	def_bool $(shields_list_contains,custom_split_right)
```
